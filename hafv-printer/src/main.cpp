#include "BluetoothSerial.h"
#include "Adafruit_Thermal.h"
#include <LiquidCrystal.h>

using namespace std;

BluetoothSerial SerialBT;
Adafruit_Thermal printer(&SerialBT);

String name = "BlueTooth Printer";
bool connected;
LiquidCrystal lcd(14, 12, 5, 18, 23, 19);

#define outputA 4
#define outputB 16
#define outputButton 17

int counter = 0; 
int aState;
int aLastState;  
int buttonState;
int lastButtonState = 0;

String authors[6] = {"Revolverman", "Fifflare", "Tjallare", "Bryggare", "Zlaktare", "Trixare"};
int stage = 0;

// Put this near the top of your sketch:
// 100 x 21 (13 bytes wide)
const uint16_t LOGO_HEIGHT = 21;
const uint16_t LOGO_WIDTH = 13;
const byte PROGMEM LOGO[] = {
  0b10011111, 0b11100001, 0b11111111, 0b01111111, 0b11111110, 0b11111111, 0b11111111, 0b11111111, 0b11111011, 0b11111101, 0b00000000, 0b00000000, 0b00000000,
  0b11111111, 0b11111111, 0b00111111, 0b11011110, 0b01111100, 0b11110111, 0b11111111, 0b10011111, 0b01110111, 0b11111110, 0b01111101, 0b11111111, 0b11010000,
  0b11110111, 0b11111111, 0b11101111, 0b11011111, 0b11111110, 0b11110101, 0b10111111, 0b01111111, 0b01010111, 0b10111110, 0b01011111, 0b11111111, 0b10010000,
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  0b11000000, 0b00011111, 0b11111111, 0b11110111, 0b11111111, 0b11111101, 0b11111111, 0b11111111, 0b11111111, 0b11111110, 0b00000000, 0b00000000, 0b00010000,
};

void print_receipt(String author, double time) {

  printer.justify('C');
  printer.printBitmap(LOGO_WIDTH, LOGO_HEIGHT, LOGO);
  printer.println();

  printer.boldOff();
  printer.setFont('B');
  printer.setSize('M');
  printer.justify('L');
  printer.print("Tid: ");
  printer.println(time);

  printer.print("Utfardad af ");
  printer.println(author);
  printer.feedRows(30);
};

void setup() {
  SerialBT.begin("ESP32test", true);  
  Serial.begin(115200);
  
  connected = SerialBT.connect(name);

  if(connected) {
    printer.begin();
    Serial.println("Connected");
  } else {
    while(!SerialBT.connected(10000)) {
    }
  }
  if (SerialBT.disconnect()) {
  }
  SerialBT.connect();

  lcd.begin(16,2);

  pinMode(outputA, INPUT);
  pinMode(outputB, INPUT);
  pinMode(outputButton, INPUT);

  aLastState = digitalRead(outputA); 
  lcd.print("Hello");
}

void loop() {
  aState = digitalRead(outputA);
  buttonState = digitalRead(outputButton);
  
  if (aState != aLastState){     
    if (digitalRead(outputB) != aState) { 
      counter++;
    }
    else {
      counter--;
    }
    if (counter >= 30 ) {
      counter = 0;
    }
    
    lcd.clear();
    lcd.print("Position: ");
    lcd.print(counter); 
    lcd.setCursor(0,0);
   }
  aLastState = aState;

  if (buttonState && !lastButtonState) {
    print_receipt("Fifflare", 3.42);
  }

  lastButtonState = buttonState;
  delay(5);
}